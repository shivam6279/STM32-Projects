#include "tones.h"
#include "main.h"
#include <math.h>
#include "BLDC.h"
#include "PWM.h"
#include "ADC.h"
#include "string_utils.h"
#include "USART.h"

// #include "wav_metroid_save.h"
// #include "wav_metroid_item.h"
#include "wav_zelda_puzzle.h"

#define WAV_FILE_BIT_DEPTH 16

#define PROGMEM __attribute__((space(prog)))

#define two_12 1.05946309436f

#define SIN_ISR_FREQ 24000.0f

#define SIN_TABLE_SIZE 4096
const float sin_table[SIN_TABLE_SIZE] = {0.0f, 0.00153398f, 0.003067957f, 0.004601926f, 0.006135885f, 0.007669829f, 0.009203755f, 0.010737659f, 0.012271538f, 0.013805389f, 0.015339206f, 0.016872988f, 0.01840673f,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 -0.003067957f, -0.00153398f};

TIM_HandleTypeDef htim12;

const uint32_t wav_size = sizeof(wav) / sizeof(wav[0]);
uint32_t wav_index = 0;
float wav_value;
float wav_amplitude_correction = 1.0f;
volatile bool play_wav = false;

float tone_power = 0.175f;  //0.015f
unsigned char tone_phase = 0;
volatile float sin_phase_delta;
volatile unsigned int sin_index = 0;
float sin_frequency = 1.0f;

const float song_metroid_theme[5][2] = {{NOTE_D5, 750}, {NOTE_F5, 750}, {NOTE_D5, 750}, {NOTE_C5, 750}, {NOTE_A4, 2000}};
float tone_amplitude = 180.0f; // Amplitude

tone_waveform_type tone_waveform = SIN;
tone_square_phase_type tone_square_phase = SIX_STEP;

void TIM12_IRQHandler(void) {
	if(TIM12->SR & 0x1) {
		TIM12->SR &= ~(0x1U);
	
		if(play_wav) {
#if WAV_FILE_BIT_DEPTH == 16
			wav_value = (int16_t)(wav[wav_index+1] << 8 | wav[wav_index]);
			wav_value /= 32767.0f;
#elif WAV_FILE_BIT_DEPTH == 8
			wav_value = (int8_t)wav[wav_index];
			wav_value /= 127.0f;
#endif

			setPhaseVoltage(tone_power*vsns_vbat * wav_value * wav_amplitude_correction, 0.0, 90.0f);

#if WAV_FILE_BIT_DEPTH == 16
			wav_index += 2;
#elif WAV_FILE_BIT_DEPTH == 8
			wav_index += 1;
#endif
			if(wav_index >= wav_size) {
				wav_index -= WAV_FILE_BIT_DEPTH / 8;
				TIM12->CR1 &= ~1U;
				play_wav = false;
				return;
			}

		} else {
			if(tone_waveform == SQUARE) {
				tone_phase = (tone_phase ^ 0x01) & 0x01;

				if(tone_square_phase == SIX_STEP) {
					MotorPhase(tone_phase, tone_power);
				} else if(tone_square_phase == FOC) {
					setPhaseVoltage(tone_power*vsns_vbat, 0, tone_phase * tone_amplitude);
				}

			} else if(tone_waveform == SIN) {
				sin_phase_delta = (float)SIN_TABLE_SIZE * sin_frequency / SIN_ISR_FREQ / 4.0f;
				sin_index = (uint32_t)(sin_index + sin_phase_delta) % SIN_TABLE_SIZE;
				setPhaseVoltage(tone_power*vsns_vbat, 0.0f, tone_amplitude * sin_table[sin_index]);
			}
		}
	}
}

void MX_TIM12_Init(void) {
	TIM_Encoder_InitTypeDef sConfig = {0};
	TIM_MasterConfigTypeDef sMasterConfig = {0};
	TIMEx_EncoderIndexConfigTypeDef sEncoderIndexConfig = {0};

	htim12.Instance = TIM12;
	htim12.Init.Prescaler = 25-1; // 10MHz after prescaler
	htim12.Init.CounterMode = TIM_COUNTERMODE_UP;
	htim12.Init.Period = 1000;
	htim12.Init.ClockDivision = TIM_CLOCKDIVISION_DIV1;
	htim12.Init.AutoReloadPreload = TIM_AUTORELOAD_PRELOAD_DISABLE;
	sConfig.EncoderMode = TIM_ENCODERMODE_TI1;
	sConfig.IC1Polarity = TIM_ICPOLARITY_RISING;
	sConfig.IC1Selection = TIM_ICSELECTION_DIRECTTI;
	sConfig.IC1Prescaler = TIM_ICPSC_DIV1;
	sConfig.IC1Filter = 0;
	sConfig.IC2Polarity = TIM_ICPOLARITY_RISING;
	sConfig.IC2Selection = TIM_ICSELECTION_DIRECTTI;
	sConfig.IC2Prescaler = TIM_ICPSC_DIV1;
	sConfig.IC2Filter = 0;
	if (HAL_TIM_Encoder_Init(&htim12, &sConfig) != HAL_OK) {
		Error_Handler();
	}
	sMasterConfig.MasterOutputTrigger = TIM_TRGO_RESET;
	sMasterConfig.MasterSlaveMode = TIM_MASTERSLAVEMODE_DISABLE;
	if (HAL_TIMEx_MasterConfigSynchronization(&htim12, &sMasterConfig) != HAL_OK) {
		Error_Handler();
	}
	sEncoderIndexConfig.Polarity = TIM_ENCODERINDEX_POLARITY_NONINVERTED;
	sEncoderIndexConfig.Prescaler = TIM_ENCODERINDEX_PRESCALER_DIV1;
	sEncoderIndexConfig.Filter = 0;
	sEncoderIndexConfig.FirstIndexEnable = DISABLE;
	sEncoderIndexConfig.Position = TIM_ENCODERINDEX_POSITION_00;
	sEncoderIndexConfig.Direction = TIM_ENCODERINDEX_DIRECTION_UP_DOWN;
	if (HAL_TIMEx_ConfigEncoderIndex(&htim12, &sEncoderIndexConfig) != HAL_OK) {
		Error_Handler();
	}

	HAL_NVIC_EnableIRQ(TIM12_IRQn);

	TIM12->CR1 &= ~1;
}

void PlayWav() {
	uint32_t i;
	int16_t val, max = 1;
	float p, f;
#if WAV_FILE_BIT_DEPTH == 16
	for(i = 0; i < wav_size; i += 2) {
		val = ((int16_t)(wav[i+1] << 8 | wav[i]));
		if(val > max) {
			max = val;
		} else if(-val > max) {
			max = -val;
		}
	}
	wav_amplitude_correction = 32767.0f / (float)max;
#elif WAV_FILE_BIT_DEPTH == 8
	for(i = 0; i < wav_size; i ++) {
		val = (int8_t)wav[i];
		if(val > max) {
			max = val;
		} else if(-val > max) {
			max = -val;
		}
	}
	wav_amplitude_correction = 127.0f / (float)max;
#endif
	
	motor_waveform_type temp = waveform_mode;
	waveform_mode = MOTOR_SVPWM;

	motor_mode temp_mode = mode;
	mode = MODE_OFF;

	tone_waveform = SIN;
	wav_index = 0;
	play_wav = true;

	setPhaseVoltage(0.1f, 0, 90.0f);
	HAL_Delay(250);

	sin_index = 0;
	f = 50000000.0f / SIN_ISR_FREQ;
	TIM12->ARR = (uint32_t)f;
	TIM12->CR1 |= 1;

	while(play_wav);
	StopTone();
	mode = MODE_OFF;
	waveform_mode = temp;
	mode = temp_mode;
}

void MetroidSaveTheme(unsigned char id) {
	unsigned int i;
	unsigned int len = sizeof(song_metroid_theme) / sizeof(song_metroid_theme[0]);
	float pitch_factor = 1;

	if(id == 1) {
		pitch_factor = 1.0f;

	} else if(id == 2) {
		pitch_factor = 2.0f;

	} else if(id == 3) {
		pitch_factor = 4.0f;
	}

	for(i = 0; i < len; i++) {
		PlayTone(song_metroid_theme[i][0] * pitch_factor);
		HAL_Delay((uint32_t)song_metroid_theme[i][1]);
	}
	
	StopTone();  
	play_tone = 0;
}

void PlayTone(float freq) {
	float f;

	if(tone_waveform == SQUARE) {
		f = 50000000.0f / (freq / 2);

	} else { // SIN
		sin_index = 0;
		sin_frequency = freq;
		sin_phase_delta = (float)SIN_TABLE_SIZE * sin_frequency / SIN_ISR_FREQ;
		f = 50000000.0f / SIN_ISR_FREQ;
	}

	TIM12->ARR = (uint32_t)f;
	
	mode = MODE_OFF;
	TIM12->CR1 |= 1;
}

void StopTone() {
	TIM12->CR1 &= ~1U;
	MotorOff();
}

void PlayNote(const char *in_str) {
	char str[5];
	unsigned char num;
	unsigned char i;
	float freq;

	str_cpy(in_str, str);
	str_toUpper(str);    

	i = str_len(str);
	
	if(!char_isDigit(str[i - 1])) {
		return;
	}

	num = str[i - 1] - '0';

	if(str[0] == 'A') {
		freq = NOTE_A0;
	} else if(str[0] == 'B') {
		freq = NOTE_B0;
	} else if(str[0] == 'C') {
		freq = NOTE_C0;
	} else if(str[0] == 'D') {
		freq = NOTE_D0;
	} else if(str[0] == 'E') {
		freq = NOTE_E0;
	} else if(str[0] == 'F') {
		freq = NOTE_F0;
	} else if(str[0] == 'G') {
		freq = NOTE_G0;
	}

	freq *= powf(2.0f, num);

	if(i >= 3) {
		if(str[1] == 'S') {
			freq *= two_12;
		}  else if(str[1] == 'F') {
			freq /= two_12;
		}
	}

	PlayTone(freq);
}

uint8_t PlayRTTLL(const char *in_str) {
	unsigned int i, j, k;

	char name_str[250];
	char settings_str[25];
	char note[10];
	char temp[5];

	unsigned char bpm, duration, octave = 0;
	float freq, delay, oct;

	// Read name
	for(i = 0; in_str[i] != ':'; i++) {
		name_str[i] = in_str[i];
		if(in_str[i] == '\0') {
			return false;
		}
	}
	name_str[i] = '\0';
	i++;

	for(j = 0; in_str[i] != ':'; i++, j++) {
		settings_str[j] = in_str[i];
		if(in_str[i] == '\0') {
			return false;
		}
	}
	settings_str[j] = '\0';
	i++;
	for(j = 1; settings_str[j] != '\0'; j++) {
		if(settings_str[j] == '=') {
			if(settings_str[j-1] == 'd') {
				j++;
				for(k = j; char_isDigit(settings_str[k]); k++) {
					temp[k-j] = settings_str[k];
				}
				temp[k] = '\0';
				j = k;
				duration = (uint8_t)str_toInt(temp);
			} else if(settings_str[j-1] == 'o') {
				j++;
				for(k = j; char_isDigit(settings_str[k]); k++) {
					temp[k-j] = settings_str[k];
				}
				temp[k] = '\0';
				j = k;
				octave = (uint8_t)str_toInt(temp);
			} else if(settings_str[j-1] == 'b') {
				j++;
				for(k = j; char_isDigit(settings_str[k]); k++) {
					temp[k-j] = settings_str[k];
				}
				temp[k] = '\0';
				j = k;
				bpm = (uint8_t)str_toInt(temp);
			}
			if(settings_str[j] == '\0') {
				break;
			}
		}
	}

	for(j = 0; ; i++) {
		if(in_str[i] == ',' || in_str[i] == '\0') {
			note[j] = '\0';
			k = 0;
			if(char_isDigit(note[k])) {
				delay = note[k++] - '0';
				if(char_isDigit(note[k])) {
					delay = delay * 10.0f + (note[k++] - '0');
				}
			} else {
				delay = duration;
			}
			delay = 1000.0f * (1.0f / delay) / ((float)bpm / 60.0f); // in ms
			
			if(!char_isAlpha(note[k])) {
				return false;
			}
			note[k] = char_toUpper(note[k]);

			if(note[k] == 'A') {
				freq = NOTE_A0;
			} else if (note[k] == 'B') {
				freq = NOTE_B0;
			} else if (note[k] == 'C') {
				freq = NOTE_C0;
			} else if (note[k] == 'D') {
				freq = NOTE_D0;
			} else if (note[k] == 'E') {
				freq = NOTE_E0;
			} else if (note[k] == 'F') {
				freq = NOTE_F0;
			} else if (note[k] == 'G') {
				freq = NOTE_G0;
			} else if (note[k] == 'P') {
				freq = -1;
			}else {
				return false;
			}
			k++;

			if(note[k]== '#') {
				k++;
				freq *= two_12;
			}

			if(char_isDigit(note[k])) {
				k++;
				oct = note[k] - '0';
			} else {
				oct = octave;
			}

			if(note[k] == '.') {
				k++;
				delay *= 1.5f;
			}

			freq *= powf(2.0f, oct);

			if(freq > 0) {
				PlayTone(freq);
			} else {
				StopTone();
			}
			// TODO: us delay
//			delay_us(delay * 100);
			j = 0;

		} else if(in_str[i] != ' ') {
			note[j++] = in_str[i];
		}
		if(in_str[i] == '\0') {
			break;
		}
	}

	StopTone();
	return 1;
}

#include "BLDC.h"
#include "main.h"
#include "stm32g4xx_it.h"
#include <math.h>

const float SVPWM_table[SVPWM_SIZE] = {0, 52.89979566, 105.7834775, 158.6349367, 211.4380742, 264.1768056, 316.8350661, 369.3968157, 421.8460433, 474.1667726, 526.3430661, 578.3590304, 630.198821,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 -105.7834775, -52.89979566};
const float SPWM_table[SVPWM_SIZE] = {0, 30.54171127, 61.07411923, 91.58792343, 122.0738291, 152.5225498, 182.9248107, 213.271351, 243.5529267, 273.7603138, 303.8843109, 333.9157419, 363.8454589,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 -61.07411923, -30.54171127};

volatile float pre_pos = 0.0, position = 0, rpm = 0, power = 0;
volatile uint8_t motor_mode = 0;

//FOC Loop
void TIM3_IRQHandler(void) {
	static int16_t cnt, pre_cnt;
	static float diff;
	if(TIM3->SR & 0x1){
		TIM3->SR &= ~(0x1);

		pre_cnt = cnt;
		cnt = -TIM8->CNT;
//		if(diff > ENCODER_RES/2) {
//			diff -= ENCODER_RES;
//		} else if(diff < -ENCODER_RES/2) {
//			diff += ENCODER_RES;
//		}
		diff = ((float)cnt - (float)pre_cnt) / ENCODER_RES * 10000.0f * 60.0f;
		if(fabs(diff) > 10000) {
			diff = rpm;
		}
		rpm = RPM_LPF * rpm + (1.0-RPM_LPF) * diff;

		pre_pos = position;
		position = (float)cnt * 360.0f / ENCODER_RES  - MOTOR_ZERO_ANGLE;
		while(position < 0.0) {
			position += 360.0;
		}
		while(position > 360.0) {
			position -= 360.0;
		}

		if(motor_mode) {
			setPhaseVoltage(power, position * POLE_PAIRS);
		}
	}
}

inline void setPhaseVoltage(float p, float angle_el) {
    static float pwm_u, pwm_v, pwm_w;

    p = p < -1.0 ? -1.0 : p > 1.0 ? 1.0 : p;
    p = -p;

	static int index;

	if(p < 0) {
		angle_el -= PHASE_DIFF;
		p = -p;
	} else {
		angle_el += PHASE_DIFF;
	}

	angle_el = fmod(angle_el, 360.0);
	if(angle_el < 0) {
		angle_el += 360.0;
	}

	index = angle_el;
	index = (index < 0.0) | (index >= SVPWM_SIZE) ? 0 : index;

	pwm_u = (float)SVPWM_table[index] * p;

	index = (index + SVPWM_INCREMENT) % SVPWM_SIZE;
	pwm_v = (float)SVPWM_table[index] * p;

	index = (index + SVPWM_INCREMENT) % SVPWM_SIZE;
	pwm_w = (float)SVPWM_table[index] * p;

	static float center, Umin, Umax;
	center = MAX_PWM / 2.0;
	Umin = fmin(pwm_u, fmin(pwm_v, pwm_w));
	Umax = fmax(pwm_u, fmax(pwm_v, pwm_w));
	center -= (Umax+Umin) / 2;
	pwm_u += center;
	pwm_v += center;
	pwm_w += center;

	set_motor_pwm(pwm_u, pwm_v, pwm_w);
}

void BLDC_phase(unsigned char phase, float p) {
	if(phase == 1) {
		TIM1->CCER |= TIM_CCER_CC1NP;
		TIM1->CCER &= ~TIM_CCER_CC2NP;
		TIM1->CCER &= ~TIM_CCER_CC3NP;
		TIM1->EGR |= TIM_EGR_COMG;
		TIM1->CCR1 = 0;
		TIM1->CCR2 = p;
		TIM1->CCR3 = 0;
	} else if(phase == 2) {
		TIM1->CCER &= ~TIM_CCER_CC1NP;
		TIM1->CCER &= ~TIM_CCER_CC2NP;
		TIM1->CCER |= TIM_CCER_CC3NP;
		TIM1->EGR |= TIM_EGR_COMG;
		TIM1->CCR1 = 0;
		TIM1->CCR2 = p;
		TIM1->CCR3 = 0;
	} else if(phase == 3) {
		TIM1->CCER &= ~TIM_CCER_CC1NP;
		TIM1->CCER |= TIM_CCER_CC2NP;
		TIM1->CCER &= ~TIM_CCER_CC3NP;
		TIM1->EGR |= TIM_EGR_COMG;
		TIM1->CCR1 = 0;
		TIM1->CCR2 = 0;
		TIM1->CCR3 = p;
	} else if(phase == 4) {
 		TIM1->CCER |= TIM_CCER_CC1NP;
 		TIM1->CCER &= ~TIM_CCER_CC2NP;
 		TIM1->CCER &= ~TIM_CCER_CC3NP;
 		TIM1->EGR |= TIM_EGR_COMG;
 		TIM1->CCR1 = 0;
 		TIM1->CCR2 = 0;
 		TIM1->CCR3 = p;
	} else if(phase == 5) {
		TIM1->CCER &= ~TIM_CCER_CC1NP;
		TIM1->CCER &= ~TIM_CCER_CC2NP;
		TIM1->CCER |= TIM_CCER_CC3NP;
		TIM1->EGR |= TIM_EGR_COMG;
		TIM1->CCR1 = p;
		TIM1->CCR2 = 0;
		TIM1->CCR3 = 0;
	} else if(phase == 6) {
		TIM1->CCER &= ~TIM_CCER_CC1NP;
		TIM1->CCER |= TIM_CCER_CC2NP;
		TIM1->CCER &= ~TIM_CCER_CC3NP;
		TIM1->EGR |= TIM_EGR_COMG;
		TIM1->CCR1 = p;
		TIM1->CCR2 = 0;
		TIM1->CCR3 = 0;
	}
}

void set_motor_pwm(uint16_t u, uint16_t v, uint16_t w) {
	u = u < 0 ? 0 : u;
	u = u > MAX_PWM ? MAX_PWM : u;

	v = v < 0 ? 0 : v;
	v = v > MAX_PWM ? MAX_PWM : v;

	w = w < 0 ? 0 : w;
	w = w > MAX_PWM ? MAX_PWM : w;

	TIM1->CCR1 = u;
	TIM1->CCR2 = v;
	TIM1->CCR3 = w;
}

void motor_on() {
	TIM1->CCER &= ~TIM_CCER_CC1NP;
	TIM1->CCER &= ~TIM_CCER_CC2NP;
	TIM1->CCER &= ~TIM_CCER_CC3NP;
}

void motor_off() {
	TIM1->CCER |= TIM_CCER_CC1NP;
	TIM1->CCER |= TIM_CCER_CC2NP;
	TIM1->CCER |= TIM_CCER_CC3NP;
	TIM1->CCR1 = 0;
	TIM1->CCR2 = 0;
	TIM1->CCR3 = 0;
}

#include "BLDC.h"
#include "main.h"
#include "stm32.h"
#include "stm32g4xx_it.h"
#include <math.h>

float SVPWM_table[SVPWM_SIZE] = {0, 13.2254525, 26.44989783, 39.6723289, 52.89173877, 66.10712072, 79.31746837, 92.52177568, 105.7190371, 118.9082476, 132.0884028, 145.2584989, 158.4175331,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 -26.44989783, -13.2254525};

int32_t motor_zero_offset = 327;
volatile float pre_pos = 0.0, position = 0, rpm = 0, power = 0;
volatile uint8_t motor_mode = 0;

volatile uint8_t current_phase = 1;
volatile float phase_timing = 0;
volatile uint8_t zero_crossing_flag = 0;

//FOC Loop
void TIM3_IRQHandler(void) {
	static int32_t cnt, pre_cnt;
	static float diff;
	if(TIM3->SR & 0x1){
		TIM3->SR &= ~(0x1);

//		GPIOB->BSRR |= 1 << 3;

		pre_cnt = cnt;
		cnt = (int16_t)TIM8->CNT;
		cnt -= motor_zero_offset;
		if(cnt < 0) {
			cnt += ENCODER_RES;
		}
		cnt = cnt % ENCODER_RES;
//		cnt &= 0x7FFF;

		diff = ((float)cnt - (float)pre_cnt) / ENCODER_RES * 20000.0f * 60.0f;
//		if(diff > ENCODER_RES/2) {
//			diff -= ENCODER_RES;
//		} else if(diff < -ENCODER_RES/2) {
//			diff += ENCODER_RES;
//		}

		if(fabs(diff) > 10000) {
			diff = rpm;
		}
		rpm = RPM_LPF * rpm + (1.0-RPM_LPF) * diff;

		position = (float)cnt * 360.0f / ENCODER_RES;
		if(position < 0) {
			position += 360.0;
		}

		if(motor_mode) {
			setPhaseVoltage(power, position * POLE_PAIRS + PHASE_DIFF);
		}

//		GPIOB->BSRR |= 1 << 19;
	}
}

void TIM1_CC_IRQHandler(void) {
	if(TIM1->SR & 1 << 4){
		TIM1->SR &= ~(1 << 4);
		if(get_COMP_value(current_phase) && TIM2->CNT > 25) {
//			phase_timing = TIM2->CNT;
			phase_timing = 0.9 * phase_timing + 0.1 * (float)TIM2->CNT;

			zero_crossing_flag = 1;

			GPIOB->BSRR |= 1 << 3;

			TIM2->CNT = 0;
//			TIM2-> ARR = phase_timing;
//			TIM2->DIER |= 1;

			TIM1->DIER &= ~(1 << 4);
		}
	}
}

void TIM2_IRQHandler(void) {
	if(TIM2->SR & 0x1){
		TIM2->SR &= ~(0x1);

//		current_phase = ((++current_phase - 1) % 6 + 1);
	}
}

inline void setPhaseVoltage(float p, float angle_el) {
    static float pwm_u, pwm_v, pwm_w;

    p = p < -1.0 ? -1.0 : p > 1.0 ? 1.0 : p;
//    p = -p;

	static int index;

	if(p < 0) {
		angle_el += 180;
		p = -p;
	}

	angle_el *= 2;
	index = angle_el;
	index = index % 720;

//	angle_el = fmod(angle_el, 360.0);
//	if(angle_el < 0) {
//		angle_el += 360.0;
//	}
//	angle_el *= 2;
//	index = angle_el;
//	index = (index < 0.0) | (index >= SVPWM_SIZE) ? 0 : index;



	pwm_u = 0.5 * SVPWM_table[index] * p;

	index = (index + SVPWM_INCREMENT) % SVPWM_SIZE;
	pwm_v = 0.5 * SVPWM_table[index] * p;

	index = (index + SVPWM_INCREMENT) % SVPWM_SIZE;
	pwm_w = 0.5 * SVPWM_table[index] * p;

	static float center;
	center = MAX_PWM / 2.0;
//	static float Umin, Umax;
//	Umin = fmin(pwm_u, fmin(pwm_v, pwm_w));
//	Umax = fmax(pwm_u, fmax(pwm_v, pwm_w));
//	center -= (Umax+Umin) / 2;
	pwm_u += center;
	pwm_v += center;
	pwm_w += center;

	set_motor_pwm(pwm_u, pwm_w, pwm_v);
}

void BLDC_phase(unsigned char phase, float p) {
	if(phase == 1) {
		TIM1->CCER |= TIM_CCER_CC1NP;
		TIM1->CCER &= ~TIM_CCER_CC2NP;
		TIM1->CCER &= ~TIM_CCER_CC3NP;
		TIM1->EGR |= TIM_EGR_COMG;
		TIM1->CCR1 = 0;
		TIM1->CCR2 = p * MAX_PWM;
		TIM1->CCR3 = 0;
	} else if(phase == 2) {
		TIM1->CCER &= ~TIM_CCER_CC1NP;
		TIM1->CCER &= ~TIM_CCER_CC2NP;
		TIM1->CCER |= TIM_CCER_CC3NP;
		TIM1->EGR |= TIM_EGR_COMG;
		TIM1->CCR1 = 0;
		TIM1->CCR2 = p * MAX_PWM;
		TIM1->CCR3 = 0;
	} else if(phase == 3) {
		TIM1->CCER &= ~TIM_CCER_CC1NP;
		TIM1->CCER |= TIM_CCER_CC2NP;
		TIM1->CCER &= ~TIM_CCER_CC3NP;
		TIM1->EGR |= TIM_EGR_COMG;
		TIM1->CCR1 = 0;
		TIM1->CCR2 = 0;
		TIM1->CCR3 = p * MAX_PWM;
	} else if(phase == 4) {
 		TIM1->CCER |= TIM_CCER_CC1NP;
 		TIM1->CCER &= ~TIM_CCER_CC2NP;
 		TIM1->CCER &= ~TIM_CCER_CC3NP;
 		TIM1->EGR |= TIM_EGR_COMG;
 		TIM1->CCR1 = 0;
 		TIM1->CCR2 = 0;
 		TIM1->CCR3 = p * MAX_PWM;
	} else if(phase == 5) {
		TIM1->CCER &= ~TIM_CCER_CC1NP;
		TIM1->CCER &= ~TIM_CCER_CC2NP;
		TIM1->CCER |= TIM_CCER_CC3NP;
		TIM1->EGR |= TIM_EGR_COMG;
		TIM1->CCR1 = p * MAX_PWM;
		TIM1->CCR2 = 0;
		TIM1->CCR3 = 0;
	} else if(phase == 6) {
		TIM1->CCER &= ~TIM_CCER_CC1NP;
		TIM1->CCER |= TIM_CCER_CC2NP;
		TIM1->CCER &= ~TIM_CCER_CC3NP;
		TIM1->EGR |= TIM_EGR_COMG;
		TIM1->CCR1 = p * MAX_PWM;
		TIM1->CCR2 = 0;
		TIM1->CCR3 = 0;
	}
}

void BEMF_phase(uint8_t phase) {
	COMP1->CSR &= ~1;
	COMP2->CSR &= ~1;

	// W falling
	if(phase == 1) {
		EXTI->IMR1 &= ~(1 << 21);
		EXTI->IMR1 |= 1 << 22;

		EXTI->RTSR1 &= ~(1 << 22);
		EXTI->FTSR1 |= 1 << 22;

		COMP2->CSR |= 0b1;
	}

	//U rising
	else if(phase == 2) {
		EXTI->IMR1 |= 1 << 21;
		EXTI->IMR1 &= ~(1 << 22);

		COMP1->CSR |= (0b111 << 4);

		EXTI->RTSR1 |= 1 << 21;
		EXTI->FTSR1 &= ~(1 << 21);

		COMP1->CSR |= 0b1;
	}

	//V falling
	else if(phase == 3) {
		EXTI->IMR1 |= 1 << 21;
		EXTI->IMR1 &= ~(1 << 22);

		COMP1->CSR |= (0b110 << 4);
		COMP1->CSR &= ~(0b001 << 4);

		EXTI->RTSR1 &= ~(1 << 21);
		EXTI->FTSR1 |= 1 << 21;

		COMP1->CSR |= 0b1;
	}

	//W rising
	else if(phase == 4) {
		EXTI->IMR1 &= ~(1 << 21);
		EXTI->IMR1 |= 1 << 22;

		EXTI->RTSR1 |= 1 << 22;
		EXTI->FTSR1 &= ~(1 << 22);

		COMP2->CSR |= 0b1;
	}

	//U falling
	else if(phase == 5) {
		EXTI->IMR1 |= 1 << 21;
		EXTI->IMR1 &= ~(1 << 22);

		COMP1->CSR |= (0b111 << 4);

		EXTI->RTSR1 &= ~(1 << 21);
		EXTI->FTSR1 |= 1 << 21;

		COMP1->CSR |= 0b1;
	}

	//V rising
	else if(phase == 6) {
		EXTI->IMR1 |= 1 << 21;
		EXTI->IMR1 &= ~(1 << 22);

		COMP1->CSR |= (0b110 << 4);
		COMP1->CSR &= ~(0b001 << 4);

		EXTI->RTSR1 |= 1 << 21;
		EXTI->FTSR1 &= ~(1 << 21);

		COMP1->CSR |= 0b1;
	}
}

uint8_t get_COMP_value(uint8_t phase) {
	uint32_t t;
	if(phase == 1) {
		t = ~COMP2->CSR;
	} else if(phase == 2) {
		t = ~COMP1->CSR;
	} else if(phase == 3) {
		t = COMP1->CSR;
	} else if(phase == 4) {
		t = COMP2->CSR;
	} else if(phase == 5) {
		t = COMP1->CSR;
	} else if(phase == 6) {
		t = ~COMP1->CSR;
	} else {
		return 0;
	}
	return (t >> 30) & 1;
}

void set_motor_pwm(uint16_t u, uint16_t v, uint16_t w) {
	u = u < 0 ? 0 : u;
	u = u > MAX_PWM ? MAX_PWM : u;

	v = v < 0 ? 0 : v;
	v = v > MAX_PWM ? MAX_PWM : v;

	w = w < 0 ? 0 : w;
	w = w > MAX_PWM ? MAX_PWM : w;

	TIM1->CCR1 = u;
	TIM1->CCR2 = v;
	TIM1->CCR3 = w;
}

void motor_on() {
	TIM1->CCER &= ~TIM_CCER_CC1NP;
	TIM1->CCER &= ~TIM_CCER_CC2NP;
	TIM1->CCER &= ~TIM_CCER_CC3NP;
}

void motor_off() {
	TIM1->CCER |= TIM_CCER_CC1NP;
	TIM1->CCER |= TIM_CCER_CC2NP;
	TIM1->CCER |= TIM_CCER_CC3NP;
	TIM1->CCR1 = 0;
	TIM1->CCR2 = 0;
	TIM1->CCR3 = 0;
}
